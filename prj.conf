## CMakeLists.txt
```
#
# Copyright (c) 2018 Nordic Semiconductor
#
# SPDX-License-Identifier: LicenseRef-Nordic-5-Clause
#
cmake_minimum_required(VERSION 3.20.0)

find_package(Zephyr REQUIRED HINTS $ENV{ZEPHYR_BASE})
project(NONE)

# NORDIC SDK APP START
target_sources(app PRIVATE
  src/main.c
  src/lbs.c
  src/flashio.c
)

# NORDIC SDK APP END
zephyr_library_include_directories(.)
```

## Kconfig
```
#
# Copyright (c) 2018 Nordic Semiconductor
#
# SPDX-License-Identifier: LicenseRef-Nordic-5-Clause
#

source "Kconfig.zephyr"

menu "Nordic LED-Button BLE GATT service sample"

config BT_LBS_SECURITY_ENABLED
	bool "Enable security"
	default n
	select BT_SMP
	select BT_SETTINGS
	select FLASH
	select FLASH_PAGE_LAYOUT
	select FLASH_MAP
	select ZMS
	select SETTINGS
	help
	  "Enable BLE security for the LED-Button service"

endmenu
```

## prj.conf
```kconfig
# Logger module
CONFIG_LOG=y
CONFIG_LOG_BUFFER_SIZE=16384


CONFIG_CBPRINTF_FP_SUPPORT=y
CONFIG_TEST_RANDOM_GENERATOR=y
CONFIG_BT_SECURITY_ERR_TO_STR=y


CONFIG_BT=y
CONFIG_BT_PERIPHERAL=y
CONFIG_BT_DEVICE_NAME="MEMS_Bluetooth"
#CONFIG_BT_GATT_LOG_LEVEL_DBG=y

CONFIG_BT_SMP=y
CONFIG_BT_FILTER_ACCEPT_LIST=y
CONFIG_BT_MAX_PAIRED=2

CONFIG_BT_SETTINGS=y
CONFIG_BT_ID_MAX=2
CONFIG_BT_COMPANY_ID=0xFFFF 


CONFIG_BT_USER_PHY_UPDATE=y
CONFIG_BT_GATT_CLIENT=y

CONFIG_BT_USER_DATA_LEN_UPDATE=y
CONFIG_BT_CTLR_DATA_LENGTH_MAX=251
CONFIG_BT_BUF_ACL_RX_SIZE=516
CONFIG_BT_BUF_ACL_TX_SIZE=516
CONFIG_BT_L2CAP_TX_MTU=512


CONFIG_FLASH=y
CONFIG_FLASH_MAP=y
CONFIG_FLASH_PAGE_LAYOUT=y

CONFIG_SETTINGS=y
CONFIG_SETTINGS_FILE=y
CONFIG_SETTINGS_FILE_PATH="/lfs1/settingsfile"
CONFIG_SETTINGS_LOG_LEVEL_DBG=y

CONFIG_FILE_SYSTEM=y
#CONFIG_FS_LOG_LEVEL_DBG=y

CONFIG_FILE_SYSTEM_LITTLEFS=y
CONFIG_PM_PARTITION_SIZE_LITTLEFS=0x12000


CONFIG_PM_DEVICE=y  
CONFIG_PM_DEVICE_RUNTIME=y
CONFIG_PM_DEVICE_LOG_LEVEL_DBG=y
CONFIG_PM_DEVICE_POWER_DOMAIN=y


CONFIG_SYSTEM_WORKQUEUE_STACK_SIZE=16384
CONFIG_MAIN_STACK_SIZE=16384

CONFIG_GPIO=y


CONFIG_DEBUG=y
CONFIG_DEBUG_INFO=y
CONFIG_DEBUG_OPTIMIZATIONS=y
```

## app.overlay
```dts
/ {
    chosen {
        zephyr,littlefs = &storage_partition;
    };
};


&uart20 {
    current-speed = <1000000>;
};
```

## nrf54l15dk_custom.overlay
```dts
/ {
    chosen {
        zephyr,littlefs = &storage_partition;
        //zephyr,settings = &storage_partition;
    };
};  
```

## src/flashio.c
```c
#include <zephyr/fs/fs.h>
#include <zephyr/fs/littlefs.h>
#include <zephyr/types.h>
#include <zephyr/logging/log.h>

#include <errno.h>

#define FS_ROOT "/lfs1"

LOG_MODULE_REGISTER(flash_logger, LOG_LEVEL_ERR);

const int create_directory(const char *full_path)
{
	int err;

	err = fs_mkdir(full_path);
	if (err < 0 && err != -EEXIST)
	{
		LOG_ERR("Failed to create directory %s. Err %d", full_path, err);
		return err;
	}
	return 0;
}

const int data_append(const char *filename, void *data, ssize_t len)
{
	int written = 0;
	struct fs_file_t l_file;
	fs_file_t_init(&l_file);

	int err = fs_open(&l_file, filename, FS_O_CREATE | FS_O_APPEND);
	if (err < 0)
	{
		LOG_ERR("Failed to open file %s. Err %d (%s)", filename, err, strerror(-err));
		return err;
	}
	else
	{
		LOG_DBG("Opened file %s.", filename);
	}

	err = fs_write(&l_file, data, len);
	if (err < 0)
	{
		LOG_ERR("Failed to append %d bytes to %s. Err %d (%s)", len, filename, err, strerror(-err));
		fs_close(&l_file);
		return err;
	}
	else
	{
		LOG_DBG("Written %d bytes to %s.", err, filename);
		written = err;
	}

	err = fs_close(&l_file);
	if (err < 0)
	{
		LOG_ERR("Failed to close file %s. Err %d (%s)", filename, err, strerror(-err));
		return err;
	}
	else
	{
		LOG_DBG("Closed file %s", filename);
	}

	return written;
}

const int data_overwrite(const char *filename, void *data, ssize_t len)
{
	int written = 0;
	struct fs_file_t l_file;
	fs_file_t_init(&l_file);

	int err = fs_open(&l_file, filename, FS_O_CREATE | FS_O_WRITE | FS_O_TRUNC);
	if (err < 0)
	{
		LOG_ERR("Failed to open file %s. Err %d (%s)", filename, err, strerror(-err));
		return err;
	}
	else
	{
		LOG_DBG("Opened file %s.", filename);
	}

	err = fs_write(&l_file, data, len);
	if (err < 0)
	{
		LOG_ERR("Failed to write %d bytes to %s. Err %d (%s)", len, filename, err, strerror(-err));
		return err;
	}
	else
	{
		LOG_DBG("Written %d bytes to %s.", err, filename);
		written = err;
	}

	err = fs_close(&l_file);
	if (err < 0)
	{
		LOG_ERR("Failed to close file %s. Err %d (%s)", filename, err, strerror(-err));
		return err;
	}
	else
	{
		LOG_DBG("Closed file %s", filename);
	}

	return written;
}

const int data_read(const char *filename, void *buf, ssize_t offset, ssize_t len)
{
	int read = 0;
	struct fs_file_t l_file;
	fs_file_t_init(&l_file);

	int err = fs_open(&l_file, filename, FS_O_CREATE | FS_O_READ);
	if (err < 0)
	{
		LOG_ERR("Failed to open file %s. Err %d (%s)", filename, err, strerror(-err));
		return err;
	}
	else
	{
		LOG_DBG("Oppened file %s.", filename);
	}

	off_t offset_setting = (off_t)offset;

	struct fs_dirent file_info;
	fs_stat(filename, &file_info);

	LOG_DBG("File read offset is set to %ld. Total file size %d", offset_setting, file_info.size);

	err = fs_seek(&l_file, offset_setting, FS_SEEK_SET);
	if (err < 0)
	{
		LOG_ERR("Failed to set file seek of file %s to %ld. Err %d (%s)", filename, offset_setting, err, strerror(-err));
		fs_close(&l_file);
		return err;
	}

	err = fs_read(&l_file, buf, len);
	if (err < 0)
	{
		LOG_ERR("Failed to read %d bytes from %s. Err %d (%s)", len, filename, err, strerror(-err));
		fs_close(&l_file);
		return err;
	}
	else
	{
		LOG_DBG("Read %d bytes from %s.", err, filename);
		read = err;
	}

	err = fs_close(&l_file);
	if (err < 0)
	{
		LOG_ERR("Failed to close file %s. Err %d (%s)", filename, err, strerror(-err));
		return err;
	}
	else
	{
		LOG_DBG("Closed file %s", filename);
	}

	return read;
}

int print_zephyr_fs_details(void) {
    struct fs_statvfs s_buf; // Declare the statvfs buffer
    int rc;

    LOG_DBG("Attempting to get filesystem statistics for path: %s", FS_ROOT);

    // Call fs_statvfs to get the filesystem information
    rc = fs_statvfs(FS_ROOT, &s_buf);

    if (rc < 0) {
        LOG_ERR("Failed to get filesystem info for %s. Error: %d", FS_ROOT, rc);
        return rc;
    }

    // Calculation for total, used, and free space in bytes
    // Using uint64_t for calculations to prevent overflow with large filesystems
    uint64_t total_blocks_val = s_buf.f_blocks;
    uint64_t free_blocks_val = s_buf.f_bfree;
    uint64_t allocation_unit_size = s_buf.f_frsize; // Use f_frsize for calculations related to f_blocks and f_bfree

    uint64_t total_space_bytes = total_blocks_val * allocation_unit_size;
    uint64_t free_space_bytes = free_blocks_val * allocation_unit_size;
    uint64_t used_space_bytes = total_space_bytes - free_space_bytes;

    LOG_INF("--- Zephyr Filesystem Information for %s ---", FS_ROOT);
    LOG_INF("  Optimal Transfer Block Size (f_bsize): %lu bytes", s_buf.f_bsize);
    LOG_INF("  Allocation Unit Size (f_frsize):       %lu bytes", s_buf.f_frsize);
    LOG_INF("  Total Blocks (f_blocks):               %lu", s_buf.f_blocks);
    LOG_INF("  Number of Free Blocks (f_bfree):       %lu", s_buf.f_bfree);

    LOG_INF("\n--- Zephyr Filesystem Space Usage ---");
    LOG_INF("  Total Space: %llu bytes", total_space_bytes);
    LOG_INF("  Used Space:  %llu bytes", used_space_bytes);
    LOG_INF("  Free Space:  %llu bytes", free_space_bytes);

    // You can also print percentages if desired
    if (total_space_bytes > 0) {
        double used_percent = (double)used_space_bytes / total_space_bytes * 100.0;
        double free_percent = (double)free_space_bytes / total_space_bytes * 100.0;
        LOG_INF("  Used Percentage: %.2f %%", used_percent);
        LOG_INF("  Free Percentage: %.2f %%", free_percent);
    } else {
        LOG_INF("  Filesystem reports 0 total space.");
    }

    return 0;
}
```

## src/flashio.h
```c
#ifndef FILEIO_H_
#define FILEIO_H_

#ifdef __cplusplus
extern "C"
{
#endif

#include <zephyr/types.h>
#include <zephyr/fs/fs.h>
#include <zephyr/fs/littlefs.h>

#define FS_ROOT "/lfs1"

#define FILE_CHAR_LOCATION FS_ROOT "/characteristics"
#define FILE_SENSOR_DATA_LOCATION FS_ROOT "/sdata"
#define FILE_LOGS_LOCATION FS_ROOT "/logs"

const int create_directory(const char *full_path);
const int data_append(const char *filename, void *data, ssize_t len);
const int data_overwrite(const char *filename, void *data, ssize_t len);
const int data_read(const char *filename, void *buf, ssize_t offset, ssize_t len);
int print_zephyr_fs_details(void);

#ifdef __cplusplus
}
#endif

/**
 * @}
 */

#endif /* FILEIO_H_ */
```

## src/lbs.h
```c
/*
 * Copyright (c) 2018 Nordic Semiconductor ASA
 *
 * SPDX-License-Identifier: LicenseRef-Nordic-5-Clause
 */

#ifndef BT_LBS_H_
#define BT_LBS_H_

/**@file
 * @defgroup bt_lbs LED Button Service API
 * @{
 * @brief API for the LED Button Service (LBS).
 */

#ifdef __cplusplus
extern "C"
{
#endif

#include <zephyr/types.h>

/** @brief App configuration Service UUID. */
#define BT_UUID_APP_CONFIG_VAL \
    BT_UUID_128_ENCODE(0x00001523, 0x1212, 0xefde, 0x1523, 0x785feabcd123)

/** @brief App runtime Service UUID. */
#define BT_UUID_APP_RUNTIME_VAL \
    BT_UUID_128_ENCODE(0x00001524, 0x1212, 0xefde, 0x1523, 0x785feabcd123)


#define BT_UUID_UNIX_TIME_VAL \
    BT_UUID_128_ENCODE(0xc0dec0fe, 0xcafe, 0xa1ca, 0x992f, 0x1b1b1b1b1b1b)
#define BT_UUID_BATTERY_LEVEL_VAL \
    BT_UUID_128_ENCODE(0xc0dec0fe, 0x0bad, 0x41c7, 0x992f, 0xa5d063dbfeee)
#define BT_UUID_TRANSMIT_POWER_VAL \
    BT_UUID_128_ENCODE(0xb1eec10a, 0x0007, 0x4d3c, 0xa1ca, 0xae3e7e098a2b)
#define BT_UUID_DEVICE_NAME_VAL \
    BT_UUID_128_ENCODE(0x00002a00, 0x0000, 0x1000, 0x8000, 0x00805f9b34fb)
#define BT_UUID_FIRMWARE_REVISION_STRING_VAL \
    BT_UUID_128_ENCODE(0xcabacafe, 0xf00d, 0x4b1b, 0x9b1b, 0x1b1b1b1b1b1b)
#define BT_UUID_DEVICE_LOG_VAL \
    BT_UUID_128_ENCODE(0xbeefc0de, 0xf00d, 0x4d3c, 0xa1ca, 0xae3e7e098a2b)
    #define BT_UUID_DEVICE_LOG_LENGTH_VAL \
    BT_UUID_128_ENCODE(0xbeefd1fa, 0xf00d, 0x4d3c, 0xa1ca, 0xae3e7e098a2b)
#define BT_UUID_MEMORY_ALLOCATED_PERCENTAGE_VAL \
    BT_UUID_128_ENCODE(0xdeadc0de, 0xbeef, 0x4b1b, 0x9b1b, 0x1b1b1b1b1b1b)
#define BT_UUID_SENSOR_DATA_LENGTH_VAL \
    BT_UUID_128_ENCODE(0x0badf00d, 0xcafe, 0x4b1b, 0x9b1b, 0x2c931b1b1b1b)
#define BT_UUID_RESPONSE_TIMEOUT_VAL \
    BT_UUID_128_ENCODE(0xf007face, 0xbabe, 0x47f5, 0xb542, 0xbbfd9b436872)
    #define BT_UUID_SENSOR_DATA_READ_CONFIRM_VAL \
    BT_UUID_128_ENCODE(0x0badf00d, 0xbabe, 0x47f5, 0xb542, 0xbbfd9b436872)
#define BT_UUID_SENSOR_DATA_VAL \
    BT_UUID_128_ENCODE(0xc0debabe, 0xface, 0x4f89, 0xb07d, 0xf9d9b20a76c8)
#define BT_UUID_CLEAR_FLASH_DATA_DISCONNECT_BIT_VAL \
    BT_UUID_128_ENCODE(0xcabba6ee, 0xc0de, 0x4414, 0xa6f6, 0x46a397e18422)
#define BT_UUID_ADVERTISING_INTERVAL_GLOBAL_VAL \
    BT_UUID_128_ENCODE(0xeeafbeef, 0xcafe, 0x4d3c, 0xa1ca, 0xae3e7e098a2b)
#define BT_UUID_ADVERTISING_DURATION_VAL \
    BT_UUID_128_ENCODE(0xbabebeef, 0xcafe, 0x4d3c, 0xa1ca, 0xae3e7e098a2b)
#define BT_UUID_ADVERTISING_INTERVAL_LOCAL_VAL \
    BT_UUID_128_ENCODE(0xc0ffee00, 0xbabe, 0x4d3c, 0xa1ca, 0xae3e7e098a2b)

#define BT_UUID_APP_RUNTIME BT_UUID_DECLARE_128(BT_UUID_APP_RUNTIME_VAL)
#define BT_UUID_APP_CONFIG BT_UUID_DECLARE_128(BT_UUID_APP_CONFIG_VAL)

#define BT_UUID_UNIX_TIME BT_UUID_DECLARE_128(BT_UUID_UNIX_TIME_VAL)
#define BT_UUID_BATTERY_LEVEL BT_UUID_DECLARE_128(BT_UUID_BATTERY_LEVEL_VAL)
#define BT_UUID_TRANSMIT_POWER BT_UUID_DECLARE_128(BT_UUID_TRANSMIT_POWER_VAL)
#define BT_UUID_DEVICE_NAME BT_UUID_DECLARE_128(BT_UUID_DEVICE_NAME_VAL)
#define BT_UUID_FIRMWARE_REVISION_STRING BT_UUID_DECLARE_128(BT_UUID_FIRMWARE_REVISION_STRING_VAL)
#define BT_UUID_DEVICE_LOG BT_UUID_DECLARE_128(BT_UUID_DEVICE_LOG_VAL)
#define BT_UUID_DEVICE_LOG_LENGTH BT_UUID_DECLARE_128(BT_UUID_DEVICE_LOG_LENGTH_VAL)
#define BT_UUID_MEMORY_ALLOCATED_PERCENTAGE BT_UUID_DECLARE_128(BT_UUID_MEMORY_ALLOCATED_PERCENTAGE_VAL)
#define BT_UUID_SENSOR_DATA_LENGTH BT_UUID_DECLARE_128(BT_UUID_SENSOR_DATA_LENGTH_VAL)
#define BT_UUID_RESPONSE_TIMEOUT BT_UUID_DECLARE_128(BT_UUID_RESPONSE_TIMEOUT_VAL)
#define BT_UUID_SENSOR_DATA_READ_CONFIRM BT_UUID_DECLARE_128(BT_UUID_SENSOR_DATA_READ_CONFIRM_VAL)
#define BT_UUID_SENSOR_DATA BT_UUID_DECLARE_128(BT_UUID_SENSOR_DATA_VAL)
#define BT_UUID_CLEAR_FLASH_DATA_DISCONNECT_BIT BT_UUID_DECLARE_128(BT_UUID_CLEAR_FLASH_DATA_DISCONNECT_BIT_VAL)
#define BT_UUID_ADVERTISING_INTERVAL_GLOBAL BT_UUID_DECLARE_128(BT_UUID_ADVERTISING_INTERVAL_GLOBAL_VAL)
#define BT_UUID_ADVERTISING_DURATION BT_UUID_DECLARE_128(BT_UUID_ADVERTISING_DURATION_VAL)
#define BT_UUID_ADVERTISING_INTERVAL_LOCAL BT_UUID_DECLARE_128(BT_UUID_ADVERTISING_INTERVAL_LOCAL_VAL)

#define FILE_BT_CHAR_TRANSMIT_POWER FILE_CHAR_LOCATION "/t_power"
#define FILE_BT_CHAR_RESPONSE_TIMEOUT FILE_CHAR_LOCATION "/resp_timeout"
#define FILE_BT_CHAR_ADVERTISING_INTERVAL_GLOBAL FILE_CHAR_LOCATION "/adv_int_g"
#define FILE_BT_CHAR_ADVERTISING_DURATION FILE_CHAR_LOCATION "/adv_dur"
#define FILE_BT_CHAR_ADVERTISING_INTERVAL_LOCAL FILE_CHAR_LOCATION "/adv_int_l"

#define FILE_BT_CHAR_DEVICE_LOG_LENGTH FILE_CHAR_LOCATION "/dev_log_len"
#define FILE_BT_CHAR_SENSOR_DATA_LENGTH FILE_CHAR_LOCATION "/s_data_len"

int char_init_values(void);

uint64_t get_sync_unix_time_ms(void);
uint64_t get_uptime_at_sync_ms(void);
void set_sensor_data_length(uint32_t length);
uint32_t get_sensor_data_length(void);
bool get_sensor_data_read_in_progress(void);
void set_sensor_data_read_in_progress(bool state);
uint16_t get_adv_dur_ms(void);
uint16_t get_adv_int_g_ms(void);

int register_device_initialized_p(bool *device_initialized);

void set_sensor_data_flash_mutex(struct k_mutex *s_data_mutex);


#ifdef __cplusplus
}
#endif

/**
 * @}
 */

#endif /* BT_LBS_H_ */
```
